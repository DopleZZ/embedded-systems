## fitocube-low/main/Kconfig.projbuild
```kconfig
menu "Soil sensor settings"

choice SOIL_SENSOR_ADC_CHANNEL
    prompt "Soil moisture ADC channel"
    default SOIL_SENSOR_ADC_CH6

config SOIL_SENSOR_ADC_CH0
    bool "ADC1_CH0 (GPIO36)"

config SOIL_SENSOR_ADC_CH1
    bool "ADC1_CH1 (GPIO37)"

config SOIL_SENSOR_ADC_CH2
    bool "ADC1_CH2 (GPIO38)"

config SOIL_SENSOR_ADC_CH3
    bool "ADC1_CH3 (GPIO39)"

config SOIL_SENSOR_ADC_CH4
    bool "ADC1_CH4 (GPIO32)"

config SOIL_SENSOR_ADC_CH5
    bool "ADC1_CH5 (GPIO33)"

config SOIL_SENSOR_ADC_CH6
    bool "ADC1_CH6 (GPIO34)"

config SOIL_SENSOR_ADC_CH7
    bool "ADC1_CH7 (GPIO35)"

endchoice

config SOIL_SENSOR_SAMPLE_PERIOD_MS
    int "Период опроса датчиков (мс)"
    range 100 3600000
    default 1000

config SOIL_SENSOR_SOIL_DRY_RAW
    int "Сырое значение ADC для сухой почвы"
    default 1200

config SOIL_SENSOR_SOIL_WET_RAW
    int "Сырое значение ADC для влажной почвы"
    default 3200

config SOIL_SENSOR_VREF_MV
    int "Опорное напряжение ADC (mV)"
    default 1100

menu "Wi-Fi"

config SOIL_SENSOR_WIFI_SSID
    string "SSID точки доступа"
    default "RT-GPON-1A38"

config SOIL_SENSOR_WIFI_PASSWORD
    string "Пароль Wi-Fi"
    default "F37ab5djig"

endmenu

menu "MQTT"

config SOIL_SENSOR_MQTT_BROKER_URI
    string "URI брокера"
    default "mqtt://azat222.ru:1883"

config SOIL_SENSOR_MQTT_CMD_TOPIC
    string "Топик для команд"
    default "soil/cmd"

config SOIL_SENSOR_MQTT_DATA_TOPIC
    string "Топик для телеметрии"
    default "soil/data"

config SOIL_SENSOR_PUBLISH_INTERVAL_MS
    int "Интервал публикации (мс)"
    default 150000

endmenu

menu "Полив / помпа"

config SOIL_SENSOR_PUMP_ENABLED
    bool "Управлять помпой через L9110S"
    default y

config SOIL_SENSOR_PUMP_IN1
    int "GPIO IN1 (L9110S)"
    range 0 48
    default 25

config SOIL_SENSOR_PUMP_IN2
    int "GPIO IN2 (L9110S)"
    range 0 48
    default 26

config SOIL_SENSOR_PUMP_MAX_DURATION_MS
    int "Максимальная длительность полива (мс)"
    range 0 3600000
    default 600000

config SOIL_SENSOR_PUMP_PWM_FREQ_HZ
    int "PWM частота для помпы (Гц)"
    range 1 40000
    default 20000

config SOIL_SENSOR_PUMP_POWER_PERCENT
    int "Мощность помпы (%)"
    range 1 100
    default 60

endmenu

menu "Датчик BME280"

config SOIL_SENSOR_BME280_ENABLED
    bool "Использовать датчик BME280"
    default y

config SOIL_SENSOR_BME280_SDA
    int "GPIO SDA"
    default 21

config SOIL_SENSOR_BME280_SCL
    int "GPIO SCL"
    default 22

config SOIL_SENSOR_BME280_I2C_ADDRESS
    hex "I2C адрес"
    default 0x76

endmenu

endmenu
```

## fitocube-low/sdkconfig.defaults
```kconfig
CONFIG_IDF_TARGET="esp32"
CONFIG_SOIL_SENSOR_ADC_CH6=y
CONFIG_SOIL_SENSOR_SAMPLE_PERIOD_MS=1000
CONFIG_SOIL_SENSOR_SOIL_DRY_RAW=2600
CONFIG_SOIL_SENSOR_SOIL_WET_RAW=1480
CONFIG_SOIL_SENSOR_VREF_MV=1100
CONFIG_SOIL_SENSOR_WIFI_SSID="RT-GPON-1A38"
CONFIG_SOIL_SENSOR_WIFI_PASSWORD="F37ab5djig"
CONFIG_SOIL_SENSOR_MQTT_BROKER_URI="mqtt://azat222.ru:1883"
CONFIG_SOIL_SENSOR_MQTT_CMD_TOPIC="soil/cmd"
CONFIG_SOIL_SENSOR_MQTT_DATA_TOPIC="soil/data"
CONFIG_SOIL_SENSOR_PUBLISH_INTERVAL_MS=150000
CONFIG_SOIL_SENSOR_PUMP_ENABLED=y
CONFIG_SOIL_SENSOR_PUMP_IN1=25
CONFIG_SOIL_SENSOR_PUMP_IN2=26
CONFIG_SOIL_SENSOR_PUMP_MAX_DURATION_MS=600000
CONFIG_SOIL_SENSOR_PUMP_PWM_FREQ_HZ=20000
CONFIG_SOIL_SENSOR_PUMP_POWER_PERCENT=60
CONFIG_SOIL_SENSOR_BME280_ENABLED=y
CONFIG_SOIL_SENSOR_BME280_SDA=21
CONFIG_SOIL_SENSOR_BME280_SCL=22
CONFIG_SOIL_SENSOR_BME280_I2C_ADDRESS=0x76
```
